#include <Arduino.h>
#include <WiFi.h>
#include <PubSubClient.h>
#include <ArduinoJson.h>

// WiFi credentials
const char* ssid = "realme";
const char* password = "55555555";
// MQTT Broker settings
const char* mqtt_server = "192.168.147.206";  // Change this to your computer's IP address
const int mqtt_port = 1883;
const char* mqtt_data_topic = "pump/data";
const char* mqtt_control_topic = "pump/control";

// Define flow sensor pins
#define INLET_FLOW_PIN 18
#define OUTLET_FLOW_PIN 19

// Define relay control pin
#define RELAY_PIN 5

// Flow sensor calibration (pulses per liter)
#define INLET_PULSES_PER_LITER 450.0
#define OUTLET_PULSES_PER_LITER 450.0

// [Previous variable declarations remain the same...]
volatile unsigned int inletPulseCount = 0;
volatile unsigned int outletPulseCount = 0;
float inletFlowRate = 0.0;
float outletFlowRate = 0.0;
unsigned long previousMillis = 0;
const long interval = 1000;
volatile unsigned long lastInletPulseTime = 0;
volatile unsigned long lastOutletPulseTime = 0;
const unsigned long debounceTime = 10;
float prevInletFlowRate = 0.0;
float prevOutletFlowRate = 0.0;
const float noiseThreshold = 0.0;
const int minValidPulses = 1;
float arduinoVibration = 0.0;
float arduinoTemperature = 0.0;
float arduinoVoltage = 0.0;
bool leakageDetected = false;
bool motorRunning = true;  // Track motor state

// WiFi and MQTT clients
WiFiClient espClient;
PubSubClient client(espClient);

// [Previous interrupt functions remain exactly the same...]
void IRAM_ATTR inletPulseCounter() {
  unsigned long currentTime = millis();
  if (currentTime - lastInletPulseTime > debounceTime) {
    inletPulseCount++;
    lastInletPulseTime = currentTime;
  }
}

void IRAM_ATTR outletPulseCounter() {
  unsigned long currentTime = millis();
  if (currentTime - lastOutletPulseTime > debounceTime) {
    outletPulseCount++;
    lastOutletPulseTime = currentTime;
  }
}

void setup_wifi() {
  delay(10);
  Serial.println();
  Serial.print("Connecting to ");
  Serial.println(ssid);

  WiFi.begin(ssid, password);

  while (WiFi.status() != WL_CONNECTED) {
    delay(500);
    Serial.print(".");
  }

  Serial.println("");
  Serial.println("WiFi connected");
  Serial.println("IP address: ");
  Serial.println(WiFi.localIP());
}

void reconnect() {
  while (!client.connected()) {
    Serial.print("Attempting MQTT connection...");
    String clientId = "ESP32Pump-";
    clientId += String(random(0xffff), HEX);

    if (client.connect(clientId.c_str())) {
      Serial.println("connected");
      // Subscribe to control topic
      client.subscribe(mqtt_control_topic);
    } else {
      Serial.print("failed, rc=");
      Serial.print(client.state());
      Serial.println(" retrying in 5 seconds");
      delay(5000);
    }
  }
}

// Callback function for MQTT messages
void callback(char* topic, byte* payload, unsigned int length) {
  if (strcmp(topic, mqtt_control_topic) == 0) {
    // Create a null-terminated string from payload
    char message[length + 1];
    memcpy(message, payload, length);
    message[length] = '\0';
    
    // Parse JSON message
    StaticJsonDocument<200> doc;
    DeserializationError error = deserializeJson(doc, message);
    
    if (error) {
      Serial.println("Failed to parse JSON message");
      return;
    }
    
    // Get command and reason
    const char* command = doc["command"];
    const char* reason = doc["reason"];
    
    // Handle motor control command
    if (strcmp(command, "off") == 0) {
      digitalWrite(RELAY_PIN, LOW);
      motorRunning = false;
      Serial.print("Motor turned OFF. Reason: ");
      Serial.println(reason);
    } else if (strcmp(command, "on") == 0) {
      digitalWrite(RELAY_PIN, HIGH);
      motorRunning = true;
      Serial.print("Motor turned ON. Reason: ");
      Serial.println(reason);
    }
  }
}

void setup() {
  Serial.begin(9600);
  
  // Initialize WiFi
  setup_wifi();
  
  // Initialize MQTT
  client.setServer(mqtt_server, mqtt_port);
  client.setCallback(callback);

  // Initialize flow sensor pins
  pinMode(INLET_FLOW_PIN, INPUT_PULLUP);
  pinMode(OUTLET_FLOW_PIN, INPUT_PULLUP);
  
  // Initialize relay pin
  pinMode(RELAY_PIN, OUTPUT);
  digitalWrite(RELAY_PIN, HIGH);  // Start with motor ON

  // Attach interrupts
  attachInterrupt(digitalPinToInterrupt(INLET_FLOW_PIN), inletPulseCounter, FALLING);
  attachInterrupt(digitalPinToInterrupt(OUTLET_FLOW_PIN), outletPulseCounter, FALLING);
}

void loop() {
  if (!client.connected()) {
    reconnect();
  }
  client.loop();

  unsigned long currentMillis = millis();

  // Read Arduino Uno data
  if (Serial.available() > 0) {
    String arduinoData = Serial.readStringUntil('\n');
    arduinoData.trim();
    int commaIndex1 = arduinoData.indexOf(',');
    int commaIndex2 = arduinoData.indexOf(',', commaIndex1 + 1);

    if (commaIndex1 != -1 && commaIndex2 != -1) {
      String vibrationStr = arduinoData.substring(0, commaIndex1);
      String temperatureStr = arduinoData.substring(commaIndex1 + 1, commaIndex2);
      String voltageStr = arduinoData.substring(commaIndex2 + 1);

      arduinoVibration = vibrationStr.toFloat();
      arduinoTemperature = temperatureStr.toFloat();
      arduinoVoltage = voltageStr.toFloat();
    }
  }

  if (currentMillis - previousMillis >= interval) {
    previousMillis = currentMillis;

    // Compute flow rates
    if (inletPulseCount >= minValidPulses) {
      inletFlowRate = (inletPulseCount / INLET_PULSES_PER_LITER) * 60.0;
    } else {
      inletFlowRate = 0;
    }

    if (outletPulseCount >= minValidPulses) {
      outletFlowRate = (outletPulseCount / OUTLET_PULSES_PER_LITER) * 60.0;
    } else {
      outletFlowRate = 0;
    }

    // Check for leakage and control relay
    if (inletFlowRate != outletFlowRate) {
      if (!leakageDetected) {
        Serial.println("Leakage Detected! Turning off relay...");
        digitalWrite(RELAY_PIN, LOW);
        motorRunning = false;
        leakageDetected = true;
      }
    } else {
      if (leakageDetected) {
        Serial.println("Leakage Stopped. Turning on relay...");
        digitalWrite(RELAY_PIN, HIGH);
        motorRunning = true;
        leakageDetected = false;
      }
    }

    // Create JSON document for MQTT
    StaticJsonDocument<200> doc;
    doc["inletFlowRate"] = inletFlowRate;
    doc["outletFlowRate"] = outletFlowRate;
    doc["vibration"] = arduinoVibration;
    doc["temperature"] = arduinoTemperature;
    doc["motorVoltage"] = arduinoVoltage;
    doc["leakageDetected"] = leakageDetected;
    doc["motorRunning"] = motorRunning;  // Add motor state to data

    // Serialize JSON to string
    char jsonBuffer[200];
    serializeJson(doc, jsonBuffer);

    // Publish to MQTT
    client.publish(mqtt_data_topic, jsonBuffer);

    // Print data to Serial (keeping original format)
    Serial.println("------------------------------------");
    Serial.print("Inlet Flow Rate: ");
    Serial.print(inletFlowRate);
    Serial.println(" L/min");
    Serial.print("Outlet Flow Rate: ");
    Serial.print(outletFlowRate);
    Serial.println(" L/min");
    Serial.print("Vibration: ");
    Serial.println(arduinoVibration);
    Serial.print("Temperature: ");
    Serial.println(arduinoTemperature);
    Serial.print("Motor Voltage: ");
    Serial.println(arduinoVoltage);
    Serial.print("Motor State: ");
    Serial.println(motorRunning ? "RUNNING" : "STOPPED");
    Serial.println("------------------------------------");

    // Reset pulse counts
    inletPulseCount = 0;
    outletPulseCount = 0;
  }

  delay(10);
}